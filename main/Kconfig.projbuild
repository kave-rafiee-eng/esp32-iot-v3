## main/Kconfig.projbuild
```kconfig
menu "Example Configuration"

    config EXAMPLE_WIFI_SSID
        string "WiFi SSID"
        default "kave"
        help
            SSID (network name) for station Wi-Fi connection.

    config EXAMPLE_WIFI_PASSWORD
        string "WiFi Password"
        default "123456789"
        help
            WiFi password (WPA or WPA2). Can be blank if the network is open.

    config BROKER_URL_RAVIS
        string "Broker URL"
        default "mqtt://109.125.149.108:1883"
        help
            URL of the broker to connect to

    config BROKER_URL_FROM_STDIN
        bool
        default y if BROKER_URL_RAVIS = "FROM_STDIN"

    config PCG_UART_TX_PIN
        int "PCG UART TX GPIO"
        default 17
        help
            GPIO number for UART2 TX used by pcgtask.

    config PCG_UART_RX_PIN
        int "PCG UART RX GPIO"
        default 16
        help
            GPIO number for UART2 RX used by pcgtask.

    config GPIO_OUTPUT_PIN
        int "RS485 DE/RE GPIO (UART RTS)"
        default 4
        help
            GPIO number connected to RS485 transceiver DE/~RE pin.
            Used as UART RTS in half-duplex RS485 mode.

    choice PCG_QUEUE_MODE
        prompt "Pending frame release order"
        default PCG_QUEUE_LIFO
        help
            Order used when a DIP SYNCK releases one MQTT frame onto the UART.

        config PCG_QUEUE_LIFO
            bool "LIFO (newest first)"
        config PCG_QUEUE_FIFO
            bool "FIFO (oldest first)"
    endchoice

    config PCG_QUEUE_DEPTH
        int "Pending serial queue depth"
        range 1 16
        default 8
        help
            Maximum MQTT-to-Advance frames held until a DIP SYNCK.
            A new frame is dropped when the queue is full.

    config PCG_SYNCK_DELAY_MS
        int "Delay after SYNCK before UART write (ms)"
        range 0 1000
        default 10
        help
            Wait after DIP SYNCK before writing one queued frame to the UART.

    config PCG_RX_FLUSH_MS
        int "UART RX coalesce delay (ms)"
        range 0 500
        default 40
        help
            Idle time to collect UART bytes before splitting PCG frames.

    config PCG_NETWORK_MONITOR_INTERVAL_MS
        int "Network monitor interval (ms)"
        range 50 10000
        default 100
        help
            How often the network monitor refreshes the status LEDs.
            Values above 100 ms are capped so the blink patterns stay visible.
            The ESP restarts after one hour.

endmenu
```
